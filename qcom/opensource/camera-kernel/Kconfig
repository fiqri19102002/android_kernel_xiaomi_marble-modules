## qcom/opensource/camera-kernel/Kconfig
```kconfig
config SPECTRA_ISP
	bool "enable camera ISP module"
	help
	  This is enabling camera ISP module.
	  IFE camera driver file be included.
	  This will enable camera ISP driver to handle IFE driver.
	  Core camera driver to handle VFE HW.

config SPECTRA_ICP
	bool "enable camera ICP module"
	help
	  This is enabling camera ICP module.
	  Camera ICP driver file be included.
	  This will enable camera ICP driver to interact with,
	  ICP FW. Which can control IPE and BPS HW.

config SPECTRA_JPEG
	bool "enable camera jpeg module"
	help
	  This is enabling camera JPEG module.
	  camera jpeg module will be functional.
	  This module interact with jpeg HW for
	  snapshot processing.

config SPECTRA_FD
	bool "enable camera FD module"
	help
	  This is enabling camera FD module.
	  Face detection hardware manager sources
	  will be included to enable the driver.

config SPECTRA_LRME
	bool "enable camera LRME module"
	help
	  This is enabling camera LRME module.
	  Low resolution motion estimation hardware
	  manager sources will be included.

config SPECTRA_SENSOR
	bool "enable camera sensor module"
	help
	  This is enabling camera sensor module.
	  sensor module files will be included to enable the driver.
	  eeprom, flash, csiphy all other module will be included
	  to make the sensor functional.

config SPECTRA_CUSTOM
	bool "enable camera custom module"
	help
	  This is enabling camera custom module.
	  Custom hardware manager sources will be
	  included to enable the driver.

config SPECTRA_OPE
	bool "enable camera OPE module"
	help
	  This is enabling camera OPE module.
	  Object processing engine hardware manager
	  sources will be included.

config SPECTRA_CRE
	bool "enable camera CRE module"
	help
	  This is enabling camera CRE module.
	  Camera request engine hardware manager
	  sources will be included.

config SPECTRA_TFE
	bool "enable camera TFE module"
	help
	  This is enabling camera TFE module.
	  Thin front end hardware manager sources
	  will be included.

config MSM_MMRM
	bool "enable MSM MMRM"
	help
	  This is enabling mmrm api access.
	  mmrm to cahce the clk voting.
	  mmrm knows about all clients' clock rates.
	  MMRM can decide whether new peak power usage is within allowed value

config MSM_GLOBAL_SYNX
	bool "enable global synx bind support"
	help
	  This is enabling the synx bind ops in cam_sync.
	  Registers the CSL fence type with the global synx
	  driver so external clients such as EVA can bind a
	  synx object to a camera fence.

config INTERCONNECT_QCOM
	bool "enabling icc bus driver"
	help
		This is to access icc driver api.
		To cache AB and IB vote will
		use ICC kernel driver API.
		So that ICC driver can consolidate the vote

config QCOM_CX_IPEAK
	bool "enable camera cx ipeak module"
	help
	  This is enabling cx ipeak voting from camera.
	  Camera driver will register with cx ipeak
	  and vote for the cx ipeak limit management.

config QCOM_BUS_SCALING
	bool "enable legacy bus scaling"
	help
	  This is enabling legacy msm bus scaling
	  driver api access for AB and IB bandwidth
	  voting on targets without interconnect.

config CAM_PRESIL
	bool "enable camera pre-silicon support"
	help
	  This is enabling camera pre-silicon emulation
	  support. Should be disabled on real silicon
	  targets so the hardware access stubs are used.
```
